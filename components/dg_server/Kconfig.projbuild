## components/dg_server/Kconfig.projbuild
```kconfig
menu "Dali Gala Server Configuration"

    config WEB_SERVER_PORT
        int "Web Server Port"
        default 80
        help
            The port on which the web server will listen for incoming requests.

endmenu
```

## components/dg_status/Kconfig.projbuild
```kconfig
menu "Dali Gala Status Configuration"

    config BLINK_GPIO
        int "Blink GPIO number"
        range ENV_GPIO_RANGE_MIN ENV_GPIO_OUT_RANGE_MAX
        default 21
        help
            GPIO number (IOxx) to blink on and off the LED.
            Some GPIOs are used for other purposes (flash connections, etc.) and cannot be used to blink.

endmenu
```

## components/dg_wifi/Kconfig.projbuild
```kconfig
menu "Dali WiFi Gala Configuration"

    config WIFI_SSID
        string "WiFi SSID"
        default "Gala"
        help
            The SSID of the WiFi network to connect to.
    
    config WIFI_PASSWORD
        string "WiFi Password"
        default "GalaDali2025"
        help
            The password of the WiFi network to connect to.

    choice WIFI_PS_LEVEL
        bool "WiFi Power Save Level"
        help
            The power save level of the WiFi device.
        config WIFI_PS_LEVEL_NONE
            bool "None"
            default true
        config WIFI_PS_LEVEL_LOW
            bool "Low"
            default false
        config WIFI_PS_LEVEL_HIGH
            bool "High"
            default false
    endchoice

    choice WIFI_MODE
        bool "WiFi Mode"
        help
            The mode of the WiFi device.
        config WIFI_MODE_AP
            bool "AP"
            default true
        config WIFI_MODE_STA
            bool "STA"
            default false
    endchoice

endmenu
```
